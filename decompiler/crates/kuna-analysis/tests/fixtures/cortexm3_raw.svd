# MINI_F4 register map
Registers are 32-bit, access not given, no defined reset value unless marked. A register's access mark holds for its fields unless they carry their own. Offsets are from the block's base; lines under a group give offsets from that group; [hi:lo] are bit positions; {n}, {i} and the like mark numbered series; 'fields as' and 'values as' point back to an identical list; <NAME> marks a mode.

## Memory map
0x40011000 USART1
0x40020000 GPIOA
0x40020400 GPIOB

## Interrupts
37 USART1

## GPIOA
Base 0x40020000
Same registers: GPIOB 0x40020400
0x00 MODER
0x04 OTYPER
0x08 OSPEEDR
0x0C PUPDR
0x10 IDR
0x14 ODR

## USART1
Base 0x40011000
0x00 SR
0x04 DR
0x08 BRR
